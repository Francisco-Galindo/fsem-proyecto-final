## package/launcher/Config.in
```kconfig
config BR2_PACKAGE_LAUNCHER
    bool "launcher"
    depends on BR2_PACKAGE_SDL2
    depends on BR2_PACKAGE_SDL2_TTF
    help
      Simple ROM launcher.
```

## package/remote/Config.in
```kconfig
config BR2_PACKAGE_REMOTE
    bool "remote"
    help
      Simple HTTP remote control server for the arcade launcher.
```

## package/splash/Config.in
```kconfig
config BR2_PACKAGE_SPLASH
    bool "splash"
    depends on BR2_PACKAGE_SDL2
    depends on BR2_PACKAGE_SDL2_TTF
    depends on BR2_PACKAGE_SDL2_MIXER
    depends on BR2_PACKAGE_SDL2_IMAGE
    help
      Boot splash screen with image and sound.
```
